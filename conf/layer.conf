## conf/layer.conf
```bitbake
# We have a conf and classes directory, add to BBPATH
BBPATH .= ":${LAYERDIR}"

# We have recipes-* directories, add to BBFILES
BBFILES += "${LAYERDIR}/recipes-*/*/*.bb \
            ${LAYERDIR}/recipes-*/*/*.bbappend"

BBFILE_COLLECTIONS += "meta-telemetry"
BBFILE_PATTERN_meta-telemetry = "^${LAYERDIR}/"
BBFILE_PRIORITY_meta-telemetry = "6"

LAYERDEPENDS_meta-telemetry = "core"
LAYERSERIES_COMPAT_meta-telemetry = "scarthgap"
```
